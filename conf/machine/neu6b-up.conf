## conf/machine/neu6b-up.conf
```bitbake
# Copyright (C) 2023 Edgeble AI Technologies Pvt. Ltd.
# Released under the MIT license (see COPYING.MIT for the terms)

#@TYPE: Machine
#@NAME: Edgeble Neural Compute Module 6B
#@DESCRIPTION: Edgeble Neural Compute Module 6B

require conf/machine/include/rk3588.inc

SOC_FAMILY = "rk3588"

# kernel
PREFERRED_PROVIDER_virtual/kernel = "linux-next-neu6b"
PREFERRED_VERSION_linux-kernel = "6.5-rc1"
LINUX_VERSION = "6.5"
PREFERRED_VERSION_linux-libc-headers = "6.5"
LINUXLIBCVERSION = "6.5"
KERNEL_VERSION_SANITY_SKIP="1"

# kernel defconfig
KBUILD_DEFCONFIG = "defconfig"

# kernel dtb
KERNEL_DEVICETREE = " \
    rockchip/rk3588-edgeble-neu6b-io.dtb \
"

# u-boot
PREFERRED_PROVIDER_virtual/bootloader = "u-boot-neu6b"
PREFERRED_VERSION_u-boot = "up"

# u-boot defconfig
UBOOT_MACHINE = "neu6b-io-rk3588_defconfig"

# xz
IMAGE_FSTYPES += "wic.xz wic.bmap"

MACHINE_FEATURES:append  = "ext2 ext3 usbhost usbgadget bluetooth"
DISTRO_FEATURES:append = "systemd bluetooth wifi"


IMAGE_INSTALL:append = " \
    kernel-modules \
    i2c-tools \
    alsa-utils \
    canutils \
    evtest \
    iperf3 \
    minicom \
    ppp \
    usbutils \
    pciutils \
"
```
